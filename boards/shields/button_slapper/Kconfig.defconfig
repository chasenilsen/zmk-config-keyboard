## boards/shields/button_slapper/Kconfig.defconfig
```kconfig
if SHIELD_BUTTON_SLAPPER_LEFT

# Name must be less than 16 characters long!
config ZMK_KEYBOARD_NAME
    default "button_slapper"

config ZMK_SPLIT_ROLE_CENTRAL
    default y

endif

if SHIELD_BUTTON_SLAPPER_LEFT || SHIELD_BUTTON_SLAPPER_RIGHT

config ZMK_SPLIT
    default y

endif
```

## boards/shields/button_slapper/Kconfig.shield
```kconfig
config SHIELD_BUTTON_SLAPPER_LEFT
    def_bool $(shields_list_contains,button_slapper_left)

# No whitespace after the comma or in your part name!
config SHIELD_BUTTON_SLAPPER_RIGHT
    def_bool $(shields_list_contains,button_slapper_right)
```
